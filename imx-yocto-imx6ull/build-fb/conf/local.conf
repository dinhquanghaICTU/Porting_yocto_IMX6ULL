## imx-yocto-imx6ull/build-fb/conf/local.conf
```bitbake
#doi sag machine cua minh
#de bitbake biet build cho board nao
MACHINE ??= 'okmx6ull-s-emmc'

#build theo distro config nào
DISTRO ?= 'fsl-imx-fb'

PACKAGE_CLASSES ?= 'package_rpm'

#gop lại nhieu tien ich cho dev de dung ssh khong can password, 
# tham khao tai trang https://docs.yoctoproject.org/4.1/ref-manual/features.html
EXTRA_IMAGE_FEATURES ?= "debug-tweaks"

# San pham production khong can ptest/test-suite.
# Tat ptest de tranh build cac goi test nhu perl-ptest va giam do phinh rootfs.
DISTRO_FEATURES:remove = "ptest"
PTEST_ENABLED = "0"

#bat tinh nang thoi gian ghi lại tung task xem hoan thanh trong bao lau lúc build
USER_CLASSES ?= "buildstats"

#qua trinh build co pacth bi loi thi bo qua build not 
PATCHRESOLVE = "noop"

#bao ve khi build
#VD: STOPTASKS,${TMPDIR},1G,100K la con duoi 1G dung nhan task moi
#VD: HALT,${TMPDIR},100M,1K la con duoi 100M thi dung han cac task
BB_DISKMON_DIRS ??= "\
    STOPTASKS,${TMPDIR},1G,100K \
    STOPTASKS,${DL_DIR},1G,100K \
    STOPTASKS,${SSTATE_DIR},1G,100K \
    STOPTASKS,/tmp,100M,100K \
    HALT,${TMPDIR},100M,1K \
    HALT,${DL_DIR},100M,1K \
    HALT,${SSTATE_DIR},100M,1K \
    HALT,/tmp,10M,1K"

#khi build song co the dung do hoa test tren may ao truoc
PACKAGECONFIG:append:pn-qemu-system-native = " sdl"

#check xem phien ban yocto dung hay chua # Yocto 4.1 → CONF_VERSION = "2" check xem 
#neu yocto dang la vesion 2 vơi version 1 se khac nhau nó check day de bao loi
CONF_VERSION = "2"

#chi dinh nhưng cai tai ve khi  build
DL_DIR ?= "${BSPDIR}/downloads/"
ACCEPT_FSL_EULA = "1"

# Dung package_rpm de tranh loi dpkg-deb goi tar duoi pseudo tren host hien tai.
# Loi gap phai: "got *at() syscall for unknown directory" / "Cannot stat: Bad address".
PACKAGE_CLASSES = "package_rpm"

# Rootfs production không cần apt/dpkg. Chỉ giữ các gói mạng thật sự
# cần; driver Wi-Fi RTL8723DU được cài riêng ở phía dưới.
IMAGE_INSTALL:append = " wpa-supplicant"

#dùng layout partition nào để tạo .wic để biết cần tạo những pattion nào 
WKS_FILE = "okmx6ull-forlinx.wks"

#output cần build ra là gì
IMAGE_FSTYPES = "wic wic.zst tar.zst"

#build DTB nào từ kernel source
KERNEL_DEVICETREE = "imx6ull-14x14-evk-emmc.dtb"

#copy file nào vào boot partition FAT 
#copy vao chuan cac phan vung de no khop voi emmc dang chia de no biet boot nhu nao

IMAGE_BOOT_FILES = " \
    zImage \
    zImage;zImage_A \
    zImage;zImage_B \
    imx6ull-14x14-evk-emmc.dtb \
    imx6ull-14x14-evk-emmc.dtb;imx6ull-14x14-evk.dtb \
    boot.scr \
"

#bitbake ota-boot-script    
# chạy trước
#→ tạo ra boot.scr

#bitbake core-image-minimal # chạy sau
#   → dùng boot.scr để tạo image
#  → boot.scr vào boot partition (qua IMAGE_BOOT_FILES)
# → rootfs không chứa ota-boot-script
EXTRA_IMAGEDEPENDS += "ota-boot-script"

BB_NUMBER_THREADS = "8"
PARALLEL_MAKE = "-j8"
PARALLEL_MAKEINST = "-j8"
IMAGE_INSTALL:append = " rtl8723du"

# SSH server và SFTP, không kéo gói OpenSSH tổng không cần thiết.
IMAGE_INSTALL:append = " openssh-sshd openssh-sftp-server"
EXTRA_IMAGE_FEATURES += "ssh-server-openssh"
# IMAGE_INSTALL:append = " openssh-sshd"

#quan ly start, stop network luc boot, them files interface de config network
IMAGE_INSTALL:append = " init-ifupdown"
#tu dong ket noi wifi luc boot
IMAGE_INSTALL:append = " wlan0-autostart"

#them mqtt mosquito
IMAGE_INSTALL:append = " mosquitto mosquitto-clients"
SYSTEMD_AUTO_ENABLE:pn-mosquitto = "enable"

#them app HNN OKM6ULL OTA
IMAGE_INSTALL:append = " hnn-okm6ull-ota"

# Banner nhận diện board và thông tin hệ thống sau khi login.
IMAGE_INSTALL:append = " system-banner"

#them lib fw_setenv  để có thể đứng ở userspace cũng có thể thao tác được với các biến env ở dưới uboot 
# dành cho mục đích ota đơn giản hơn 
IMAGE_INSTALL:append = " libubootenv-bin"

#them config cho evn 
IMAGE_INSTALL:append = " u-boot-env-config"

# zstd, mke2fs và fw_setenv là dependency của hnn-okm6ull-ota recipe.
```

## imx-yocto-imx6ull/meta-okmx6ull/conf/layer.conf
```bitbake
#doan nay la de cho bitbake biet file metadata này o dau sau nay no can dung den bien BBPATH
BBPATH .= ":${LAYERDIR}"


#doan nay là de scan tat ca cac file .bb va .bbappend sau no chi can goi bien BBFILES lai

BBFILES += "${LAYERDIR}/recipes-*/*/*.bb \
            ${LAYERDIR}/recipes-*/*/*.bbappend"

#dinh danh layer de bitbake biet thuoc layer nao
BBFILE_COLLECTIONS += "meta-okmx6ull"

#sau khi dinh danh song bitbake can biet duong dan cua no
BBFILE_PATTERN_meta-okmx6ull = "^${LAYERDIR}/"
# nếu nhiều layer/recipe/metadata conflict thì ưu tiên layer priority cao hơn
BBFILE_PRIORITY_meta-okmx6ull = "10"

#no se khai bao dung lai nhung thu cua core nhu cac ham, cac bien core da viet san 
LAYERDEPENDS_meta-okmx6ull = "core"

#khai bao cho biet su dung version nao, moi vison se co cu phap khac nhau
LAYERSERIES_COMPAT_meta-okmx6ull = "kirkstone"
```

## imx-yocto-imx6ull/meta-okmx6ull/conf/machine/okmx6ull-s-emmc.conf
```bitbake
MACHINEOVERRIDES =. "mx6:mx6ul:mx6ull:"

include conf/machine/include/imx-base.inc
include conf/machine/include/arm/armv7a/tune-cortexa7.inc

# Chỉ định kernel device tree cho board
KERNEL_DEVICETREE = "imx6ull-14x14-evk-emmc.dtb"

# Chọn U-Boot config mặc định cho machine
UBOOT_CONFIG ?= "emmc"

# emmc:
# - dùng U-Boot defconfig mx6ull_14x14_evk_emmc_config
# - dùng boot media/layout kiểu sdcard (MMC/eMMC)
UBOOT_CONFIG[emmc] = "okmx6ull_s_emmc_defconfig,sdcard"

# Serial console UART1
SERIAL_CONSOLES = "115200;ttymxc0"
```

## imx-yocto-imx6ull/meta-okmx6ull/recipes-bsp/u-boot/files/okmx6ull_s_emmc_defconfig
```kconfig
CONFIG_ARM=y
CONFIG_ARCH_MX6=y
CONFIG_SYS_MALLOC_LEN=0x1000000
CONFIG_NR_DRAM_BANKS=1
CONFIG_SYS_MEMTEST_START=0x80000000
CONFIG_SYS_MEMTEST_END=0x88000000

# biết biến môi trường size bao nhiêu 
CONFIG_ENV_SIZE=0x2000

#tại sao nó tìm được thấy biến môi trường trên emmc 
CONFIG_ENV_OFFSET=0x400000

CONFIG_MX6ULL=y
CONFIG_TARGET_MX6ULL_14X14_EVK=y
# CONFIG_SYS_I2C_MXC_I2C1 is not set
# CONFIG_SYS_I2C_MXC_I2C2 is not set
CONFIG_DM_GPIO=y
CONFIG_DEFAULT_DEVICE_TREE="imx6ull-14x14-evk-emmc"
# CONFIG_SUPPORT_RAW_INITRD is not set
CONFIG_USE_BOOTCOMMAND=y

/*
1. run findfdt
tìm đúng file .dtb (device tree) phù hợp với board
→ set biến $fdt_file
tại sao nó biết được file nào qua biến này nó do config 
CONFIG_DEFAULT_FDT_FILE="imx6ull-14x14-evk-emmc.dtb"

2. mmc dev ${mmcdev} (2 lần)
chọn MMC device (mmcdev thường = 1 cho eMMC)
gọi 2 lần để đảm bảo init xong

nó do config này CONFIG_SYS_MMC_ENV_DEV

3. if mmc rescan
kiểm tra eMMC có hoạt động không
    → không scan được → run netboot (boot qua mạng)
    → scan được      → tiếp tục

4. if run loadbootscript
tìm file boot.scr trên eMMC
    → có boot.scr → run bootscript (chạy script tùy chỉnh)
    → không có   → tiếp tục

5. if run loadimage
tìm kernel image (zImage) trên eMMC
    → có kernel → run mmcboot (boot từ eMMC)
    → không có  → run netboot (boot qua mạng TFTP)


    findfdt
    ↓
mmc rescan
    ├── FAIL → netboot
    └── OK
         ↓
    loadbootscript
         ├── OK → bootscript (boot.scr)
         └── FAIL
              ↓
         loadimage
              ├── OK → mmcboot (boot kernel từ eMMC)
              └── FAIL → netboot (TFTP)



              /home/quanghaictu/learn_yocto/imx-yocto-imx6ull/meta-okmx6ull/recipes-bsp/ota-boot-script/files/boot.cmd


nếu muốn xem nó deconfig như nào 
/home/quanghaictu/learn_yocto/imx-yocto-imx6ull/build-fb/tmp/work/x86_64-linux/u-boot-imx-tools-native/2022.04-r0/git/include/configs/mx6ullevk.h (line 91)
*/
CONFIG_BOOTCOMMAND="run findfdt; mmc dev 1; if mmc rescan; then if run loadbootscript; then run bootscript; else if run loadimage; then run mmcboot; fi; fi; fi"

/*if waitpwrkey 5000; then ledblink 3 100;*/

CONFIG_BOOTDELAY=0
CONFIG_BOOTCOUNT_LIMIT=y
CONFIG_BOOTCOUNT_ENV=y
CONFIG_BOOTCOUNT_BOOTLIMIT=3
# CONFIG_CONSOLE_MUX is not set
# CONFIG_SYS_CONSOLE_IS_IN_ENV is not set
CONFIG_BOARD_EARLY_INIT_F=y
CONFIG_HUSH_PARSER=y
CONFIG_CMD_BOOTZ=y
# CONFIG_CMD_IMLS is not set
# CONFIG_CMD_MEMTEST is not set
CONFIG_CMD_GPIO=y
# CONFIG_CMD_I2C is not set
CONFIG_CMD_MMC=y
# CONFIG_CMD_SF is not set
# CONFIG_CMD_USB is not set
# CONFIG_CMD_DHCP is not set
# CONFIG_CMD_PING is not set
CONFIG_CMD_BMP=y
CONFIG_CMD_CACHE=y
# CONFIG_CMD_NET is not set
CONFIG_CMD_BOOTCOUNT=y
CONFIG_CMD_EXT2=y
CONFIG_CMD_EXT4=y
CONFIG_CMD_EXT4_WRITE=y

# đoạn này đã bật FAT này nên nó đọc được FAT
#U-Boot có driver FAT nhỏ gọn được compile sẵn 
#fatload là lệnh built-in, chạy được ngay từ đầu không cần gì thêm

CONFIG_CMD_FAT=y
# CONFIG_CMD_FS_GENERIC is not set
CONFIG_OF_CONTROL=y
CONFIG_ENV_OVERWRITE=y
CONFIG_ENV_IS_IN_MMC=y
CONFIG_SYS_RELOC_GD_ENV_ADDR=y
CONFIG_SYS_MMC_ENV_DEV=1
CONFIG_ENV_VARS_UBOOT_RUNTIME_CONFIG=y
CONFIG_BOUNCE_BUFFER=y
CONFIG_DM_74X164=y
CONFIG_DM_I2C=y
CONFIG_SYS_I2C_MXC=y
CONFIG_FSL_USDHC=y
# CONFIG_MTD is not set
# CONFIG_DM_SPI_FLASH is not set
CONFIG_SF_DEFAULT_SPEED=40000000
# CONFIG_SPI_FLASH_STMICRO is not set
CONFIG_PHYLIB=y
CONFIG_PHY_MICREL=y
CONFIG_PHY_MICREL_KSZ8XXX=y
CONFIG_DM_ETH=y
CONFIG_DM_ETH_PHY=y
CONFIG_FEC_MXC=y
CONFIG_MII=y
CONFIG_PINCTRL=y
CONFIG_PINCTRL_IMX6=y
CONFIG_DM_REGULATOR=y
CONFIG_DM_REGULATOR_FIXED=y
CONFIG_DM_REGULATOR_GPIO=y
CONFIG_MXC_UART=y
CONFIG_SPI=y
CONFIG_DM_SPI=y
# CONFIG_FSL_QSPI is not set
CONFIG_SOFT_SPI=y
CONFIG_IMX_THERMAL=y
CONFIG_USB=y
CONFIG_USB_STORAGE=y
CONFIG_CMD_USB_MASS_STORAGE=y
CONFIG_USB_HOST_ETHER=y
CONFIG_USB_ETHER_ASIX=y
# CONFIG_DM_VIDEO is not set
# CONFIG_VIDEO_LOGO is not set
CONFIG_SYS_WHITE_ON_BLACK=y
# CONFIG_VIDEO_MXS is not set
CONFIG_SPLASH_SCREEN=y
CONFIG_SPLASH_SCREEN_ALIGN=y
CONFIG_BMP_16BPP=y

# CONFIG_USB_GADGET is not set
# CONFIG_USB_GADGET_DOWNLOAD is not set
CONFIG_USB_GADGET_MANUFACTURER="FSL"
CONFIG_USB_GADGET_VENDOR_NUM=0x1fc9
CONFIG_USB_GADGET_PRODUCT_NUM=0x0152
# CONFIG_CI_UDC is not set

# CONFIG_CMD_FASTBOOT is not set
# CONFIG_USB_FUNCTION_FASTBOOT is not set
# CONFIG_FASTBOOT_UUU_SUPPORT is not set
# CONFIG_FASTBOOT is not set

CONFIG_FASTBOOT_BUF_ADDR=0x83800000
CONFIG_FASTBOOT_BUF_SIZE=0x40000000
# CONFIG_FASTBOOT_FLASH is not set
CONFIG_EFI_PARTITION=y
CONFIG_ARCH_MISC_INIT =y
# CONFIG_DM_RNG is not set
# CONFIG_CMD_RNG is not set
# CONFIG_FSL_DCP_RNG is not set
# CONFIG_OF_SYSTEM_SETUP is not set
CONFIG_CMD_CRC32=y
CONFIG_CRC32_VERIFY=y


#là địa chỉ RAM nơi U-Boot proper bắt đầu chaỵ
#no duoc ghi de file cua hang /home/quanghaictu/learn_yocto/imx-yocto-imx6ull/build-fb/tmp/work/okmx6ull_s_emmc-poky-linux-gnueabi/u-boot-imx/2022.04-r0/build/okmx6ull_s_emmc_defconfig/.config
#cái này có thể chỉnh được 
CONFIG_SYS_TEXT_BASE=0x87800000

CONFIG_DEFAULT_FDT_FILE="imx6ull-14x14-evk-emmc.dtb"
CONFIG_OF_LIST="imx6ull-14x14-evk-emmc"
```

## imx-yocto-imx6ull/meta-okmx6ull/wic/okmx6ull-forlinx.wks
```
# Ghi file U-Boot raw image vao dau disk.
# Day khong phai partition binh thuong nen dung --no-table.
part u-boot --source rawcopy --sourceparams="file=u-boot.imx" --ondisk mmcblk --no-table --align 1

# Tao boot partition dang FAT.
# Cac file trong IMAGE_BOOT_FILES se duoc copy vao partition nay:
# zImage, zImage_A, zImage_B, DTB, boot.scr...
part /boot --source bootimg-partition --ondisk mmcblk --fstype=vfat --label BOOT --active --align 8192 --size 120

# Tao rootfs A.
# Noi dung lay tu rootfs do Yocto build ra.
# Slot A se boot voi root=/dev/mmcblk1p2.
part / --source rootfs --ondisk mmcblk --fstype=ext4 --label rootfs_A --align 8192 --fixed-size 512M

# Tao rootfs B.
# Ban dau copy cung rootfs Yocto de slot B boot duoc.
# Slot B se boot voi root=/dev/mmcblk1p3.
part --source rootfs --ondisk mmcblk --fstype=ext4 --label rootfs_B --align 8192 --fixed-size 512M

# Dung partition table kieu MBR/msdos.
bootloader --ptable msdos
```
